// These arguments were used when this file was generated. They will be automatically applied on subsequent loads 
// via the GUI or CLI invocations. Run CLI with '--help' for additional information on how to override these arguments.
// @cliArgs --board "/ti/boards/MSP_EXP432P401R" --product "simplelink_msp432p4_sdk@3.40.00.05"
// @versions {"data":"2019103101","timestamp":"2019103101","tool":"1.3.1030","templates":"2019103101"}

var RTOS = scripting.addModule("/ti/drivers/RTOS");
var GPIO = scripting.addModule("/ti/drivers/GPIO");
var GPIO1 = GPIO.addInstance();
var GPIO2 = GPIO.addInstance();
var GPIO3 = GPIO.addInstance();
var GPIO4 = GPIO.addInstance();
var GPIO5 = GPIO.addInstance();
var GPIO6 = GPIO.addInstance();
var UART = scripting.addModule("/ti/drivers/UART", {}, false);
var UART1 = UART.addInstance();
var UART2 = UART.addInstance();
var I2C = scripting.addModule("/ti/drivers/I2C", {}, false);
var I2C1 = I2C.addInstance();
// Name
RTOS.timer0.resource.$name = "MyTIMER_A1";
var Power = scripting.addModule("/ti/drivers/Power", {}, false);
// Name
Power.performanceLevel3.$name = "ti_drivers_power_PowerMSP432PerfLevels0";
// Name
Power.performanceLevel2.$name = "ti_drivers_power_PowerMSP432PerfLevels1";
// Name
Power.performanceLevel1.$name = "ti_drivers_power_PowerMSP432PerfLevels2";
// Name
Power.performanceLevel0.$name = "ti_drivers_power_PowerMSP432PerfLevels3";
var Board = scripting.addModule("/ti/drivers/Board", {}, false);
var DriverLib = scripting.addModule("/ti/devices/DriverLib", {}, false);
// Use Hardware - Select the hardware to use, or 'None' to use available header pins
GPIO1.$hardware = system.deviceData.board.components.S1;
// Mode - Select the GPIO mode
GPIO1.mode = "Dynamic";
// Name - The C/C++ identifier used in applications as the index parameter passed to GPIO runtime APIs
GPIO1.$name = "CONFIG_GPIO_BUTTON_0";
// Use Hardware - Select the hardware to use, or 'None' to use available header pins
GPIO2.$hardware = system.deviceData.board.components.S2;
// Mode - Select the GPIO mode
GPIO2.mode = "Dynamic";
// Name - The C/C++ identifier used in applications as the index parameter passed to GPIO runtime APIs
GPIO2.$name = "CONFIG_GPIO_BUTTON_1";
// Use Hardware - Select the hardware to use, or 'None' to use available header pins
GPIO3.$hardware = system.deviceData.board.components.LED1_RED;
// Name - The C/C++ identifier used in applications as the index parameter passed to GPIO runtime APIs
GPIO3.$name = "CONFIG_GPIO_LED_0";
// Use Hardware - Select the hardware to use, or 'None' to use available header pins
GPIO4.$hardware = system.deviceData.board.components.LED2_RED;
// Name - The C/C++ identifier used in applications as the index parameter passed to GPIO runtime APIs
GPIO4.$name = "CONFIG_GPIO_LED_1";
// Use Hardware - Select the hardware to use, or 'None' to use available header pins
GPIO5.$hardware = system.deviceData.board.components.LED2_GREEN;
// Name - The C/C++ identifier used in applications as the index parameter passed to GPIO runtime APIs
GPIO5.$name = "CONFIG_GPIO_LED_2";
// Use Hardware - Select the hardware to use, or 'None' to use available header pins
GPIO6.$hardware = system.deviceData.board.components.LED2_BLUE;
// Name - The C/C++ identifier used in applications as the index parameter passed to GPIO runtime APIs
GPIO6.$name = "CONFIG_GPIO_LED_3";
// Name - The C/C++ identifier used in applications as the index parameter passed to UART runtime APIs
UART1.$name = "CONFIG_UART_0";
// Use Hardware - Select the hardware to use, or 'None' to use available header pins
UART1.$hardware = system.deviceData.board.components.XDS110UART;
// Name
UART1.uart.$name = "MyUART1";
// Use Peripheral
UART1.uart.$assign = "EUSCI_A0";
// Name - The C/C++ identifier used in applications as the index parameter passed to UART runtime APIs
UART2.$name = "CONFIG_UART_1";
// Baud Rates - The set of baud rates that are used by this instance. On some devices, these rates are used to pre-compute a table of clock dividers necessary for each rate.
UART2.baudRates = [9600];
// Name
UART2.uart.$name = "MyUART1";
// Use Peripheral
UART2.uart.$assign = "EUSCI_A1";
// Assign pin
UART2.uart.txPin.$assign = "boosterpack.4"; // P3.3
// Assign pin
UART2.uart.rxPin.$assign = "boosterpack.3"; // P3.2
// Name - The C/C++ identifier used in applications as the index parameter passed to I2C runtime APIs
I2C1.$name = "CONFIG_I2C_0";
// Name
I2C1.i2c.$name = "MyI2C1";
// Suggest solution
RTOS.timer0.resource.$suggestSolution = "Timer_A0";
// Suggest solution
GPIO1.gpioPin.$suggestSolution = "5";
// Suggest solution
GPIO2.gpioPin.$suggestSolution = "8";
// Suggest solution
GPIO3.gpioPin.$suggestSolution = "4";
// Suggest solution
GPIO4.gpioPin.$suggestSolution = "16";
// Suggest solution
GPIO5.gpioPin.$suggestSolution = "17";
// Suggest solution
GPIO6.gpioPin.$suggestSolution = "18";
// Suggest solution
UART1.uart.txPin.$suggestSolution = "7";
// Suggest solution
UART1.uart.rxPin.$suggestSolution = "6";
// Suggest solution
I2C1.i2c.$suggestSolution = "EUSCI_B1";
// Suggest solution
I2C1.i2c.sdaPin.$suggestSolution = "78";
// Suggest solution
I2C1.i2c.sclPin.$suggestSolution = "79";
